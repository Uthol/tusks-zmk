/*
 * Copyright (c) 2024 Uthol
 *
 * SPDX-License-Identifier: MIT
 */

#include "tusks.dtsi"

&kscan0 {
    col-gpios
        = <&gpio1 4 GPIO_ACTIVE_HIGH>
        , <gpio0 22 GPIO_ACTIVE_HIGH>
        , <gpio0 20 GPIO_ACTIVE_HIGH>
        , <gpio1 0 GPIO_ACTIVE_HIGH>
        , <gpio0 24 GPIO_ACTIVE_HIGH>
        , <gpio1 11 GPIO_ACTIVE_HIGH>
        ;
};
