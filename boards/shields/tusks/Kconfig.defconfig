## boards/shields/tusks/Kconfig.defconfig
```kconfig
# Copyright (c) 2022 The ZMK Contributors
# SPDX-License-Identifier: MIT

if SHIELD_TUSKS_DONGLE

config ZMK_KEYBOARD_NAME
    default "Tusks"

config ZMK_SPLIT_ROLE_CENTRAL
    default y

endif

if SHIELD_TUSKS_LEFT || SHIELD_TUSKS_RIGHT || SHIELD_TUSKS_DONGLE

config ZMK_SPLIT
    default y

endif
```

## boards/shields/tusks/Kconfig.shield
```kconfig
# Copyright (c) 2022 The ZMK Contributors
# SPDX-License-Identifier: MIT

config SHIELD_TUSKS_LEFT
    def_bool $(shields_list_contains,tusks_left)

config SHIELD_TUSKS_RIGHT
    def_bool $(shields_list_contains,tusks_right)

config SHIELD_TUSKS_DONGLE
    def_bool $(shields_list_contains,tusks_dongle)
```

## config/Kconfig.defconfig
```kconfig
if SHIELD_TUSKS_LEFT

config ZMK_KEYBOARD_NAME
    default "Tusk MK II"

config ZMK_SPLIT_ROLE_CENTRAL
    default y

endif

if SHIELD_TUSKS_LEFT || SHIELD_TUSKS_RIGHT

config ZMK_SPLIT
    default y
```

## config/Kconfig.shield
```kconfig
# Copyright (c) 2024 Uthol
# SPDX-License-Identifier: MIT

config SHIELD_TUSKS_LEFT
    def_bool $(shields_list_contains,tusks_left)

config SHIELD_TUSKS_RIGHT
    def_bool $(shields_list_contains,tusks_right)
```
